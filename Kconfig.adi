## Kconfig.adi
```kconfig
# This file exists solely to be include in the main Kconfig

config KERNEL_ALL_ADI_DRIVERS
	tristate "Build all Analog Devices Kernel Drivers"
	select IIO

source "drivers/iio/Kconfig.adi"
```

## drivers/iio/Kconfig.adi
```kconfig
# This file exists solely to be include in Kconfig.adi
# It's a bit of hurry-ed-up job; many symbols need to be depended
# on I2C or SPI, but that can be done later; the ADI image has
# these symbols enabled anyway

config IIO_ALL_ADI_DRIVERS
	tristate "Build all Analog Devices IIO Drivers"
	select AD9528
	select ADRV9009
	select AXI_ADXCVR
	select AXI_JESD204_TX
	select AXI_JESD204_RX
	select CF_AXI_ADC
	select CF_AXI_DDS
	select CF_AXI_DDS_AD9122
```

## drivers/iio/jesd204/Kconfig
```kconfig
if JESD204

config AXI_ADXCVR
	tristate "Analog Devices AXI ADXCVR PHY Support"
	depends on COMMON_CLK
	select XILINX_TRANSCEIVER

config AXI_JESD204_TX
	tristate "Analog Devices AXI JESD204B TX Support"
	depends on COMMON_CLK
	select REGMAP_MMIO

config AXI_JESD204_RX
	tristate "Analog Devices AXI JESD204B RX Support"
	depends on COMMON_CLK
	select REGMAP_MMIO

config XILINX_TRANSCEIVER
	tristate

endif
```
